## boards/shields/knot_p/Kconfig.defconfig
```kconfig
if SHIELD_KNOT_P

    config ZMK_KEYBOARD_NAME
        default "knot_p"

    config INPUT
        default y
    
    config ZMK_POINTING
        default y
    
    config ZMK_MOUSE
        default y

    config I2C
        default y
    
    config INPUT_PINNACLE
        default y

    config MAIN_STACK_SIZE
        default 4096
    
    config INPUT_THREAD_STACK_SIZE
        default 4096

endif
```

## config/west.yml
```yaml
manifest:
  remotes:
    - name: zmkfirmware
      url-base: https://github.com/zmkfirmware
    - name: halfdane
      url-base: https://github.com/halfdane/
    - name: hsgw
      url-base: https://github.com/hsgw/
    # Additional modules containing boards/shields/custom code can be listed here as well
    # See https://docs.zephyrproject.org/3.2.0/develop/west/manifest.html#projects
  projects:
    - name: zmk
      remote: zmkfirmware
      revision: main
      import: app/west.yml
    - name: zmk-input-gestures
      remote: halfdane
      revision: main
    - name: zmk-input-processors
      remote: halfdane
      revision: main
    - name: cirque-input-module
      remote: hsgw
      revision: main
  self:
    path: config
```
